## src/mainboard/dell/xps_8300/Kconfig
```kconfig
if BOARD_DELL_XPS_8300

config BOARD_SPECIFIC_OPTIONS
	def_bool y
	select BOARD_ROMSIZE_KB_4096
	select HAVE_ACPI_RESUME
	select HAVE_ACPI_TABLES
	select INTEL_INT15
	select NORTHBRIDGE_INTEL_SANDYBRIDGE
	select SERIRQ_CONTINUOUS_MODE
	select SOUTHBRIDGE_INTEL_BD82X6X
	select USE_NATIVE_RAMINIT
	select HAVE_IFD_BIN
    select HAVE_ME_BIN

config MAINBOARD_DIR
	string
	default "dell/xps_8300"

config MAINBOARD_PART_NUMBER
	string
	default "XPS 8300"

config DRAM_RESET_GATE_GPIO # FIXME: check this
	int
	default 60

config USBDEBUG_HCD_INDEX
	int
	default 2

config VGA_BIOS_DGPU_ID
	default "10de,1082"

endif
```
